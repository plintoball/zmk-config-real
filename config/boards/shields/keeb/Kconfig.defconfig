## config/boards/shields/keeb/Kconfig.defconfig
```kconfig
if SHIELD_KEEB_LEFT

config ZMK_KEYBOARD_NAME
    default "keeb"

config ZMK_SPLIT_ROLE_CENTRAL
    default y

endif

if SHIELD_KEEB_LEFT || SHIELD_KEEB_RIGHT

config ZMK_SPLIT
    default y

endif
```
